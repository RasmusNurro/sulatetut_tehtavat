## build/Kconfig/boards/Kconfig.nrf5340_audio_dk
```kconfig
# Load board Kconfig descriptions.
osource "C:/ncs/v3.1.1/zephyr/boards/nordic/nrf5340_audio_dk/Kconfig.nrf5340_audio_dk"
```

## build/sulatetut/Kconfig/boards/Kconfig.sysbuild
```kconfig
# Load Sysbuild board Kconfig descriptions.
osource "C:/ncs/v3.1.1/zephyr/boards/nordic/nrf5340_audio_dk/Kconfig.sysbuild"
```
